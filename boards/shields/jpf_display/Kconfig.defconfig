## boards/shields/jpf_display/Kconfig.defconfig
```kconfig
# Copyright (c) 2024 The ZMK Contributors
# SPDX-License-Identifier: MIT

if SHIELD_JPF_ADAPTER

choice ZMK_DISPLAY_STATUS_SCREEN
    default ZMK_DISPLAY_STATUS_SCREEN_CUSTOM
endchoice

config ZMK_DISPLAY_STATUS_SCREEN_CUSTOM
    select LV_USE_LABEL
    select LV_USE_IMG
    select LV_USE_CANVAS
    select LV_USE_ANIMIMG 
    select LV_USE_ANIMATION
    select LV_USE_LINE 
    select LV_FONT_UNSCII_8
    select ZMK_WPM
    imply ZMK_HID_INDICATORS

config ZMK_DONGLE_DISPLAY_DONGLE_BATTERY
    bool "Show also the battery level of the dongle"
    depends on BT && (!ZMK_SPLIT_BLE || ZMK_SPLIT_ROLE_CENTRAL)

choice ZMK_DISPLAY_WORK_QUEUE
    default ZMK_DISPLAY_WORK_QUEUE_DEDICATED
endchoice

config ZMK_DISPLAY_DEDICATED_THREAD_STACK_SIZE
    default 4096

choice ST7789V_PIXEL_FORMAT
	default ST7789V_RGB565
endchoice

config LV_Z_VDB_SIZE
    default 100

config LV_Z_MEM_POOL_SIZE
    default 10000

config LV_DPI_DEF
    default 261

config LV_Z_BITS_PER_PIXEL
	default 16

choice LV_COLOR_DEPTH
	default LV_COLOR_DEPTH_16
endchoice

config LV_COLOR_16_SWAP
	default y

config LV_DISP_DEF_REFR_PERIOD
    default 20

choice LV_FONT_DEFAULT
    default LV_FONT_DEFAULT_MONTSERRAT_20
endchoice

config LV_FONT_MONTSERRAT_40
    default y

config PWM
    default y

config LED
    default y

config DISPLAY_IDLE_TIMEOUT_S
    int "Display idle timeout in seconds (0 = never off)"
    default 600
    help
      Time in seconds after which the display turns off when idle. 0 = never off.

config DISPLAY_MAX_BRIGHTNESS
    int "Maximum display brightness (1-100)"
    default 80
    range 1 100

config DISPLAY_MIN_BRIGHTNESS
    int "Minimum display brightness (0-99, 0 = off)"
    default 0
    range 0 99

config DISPLAY_BRIGHTNESS_KEYBOARD_CONTROL
    bool "Control display brightness via keyboard"
    default y
    help
      Allows controlling the display brightness via keyboard (e.g. F23/F24).

config DISPLAY_BRIGHTNESS_UP_KEYCODE
    int "Keycode for increasing display brightness"
    default 115  # KC_F24
    help
      Keycode that increases the display brightness (default: F23).

config DISPLAY_BRIGHTNESS_DOWN_KEYCODE
    int "Keycode for decreasing display brightness"
    default 114  # KC_F23
    help
      Keycode that decreases the display brightness (default: F24).

config DISPLAY_BRIGHTNESS_STEP
    int "Step for brightness adjustment with keyboard"
    default 10
    help
      How much brightness steps (range MIN_BRIGHTNESS to MAX_BRIGHTNESS) should be applied per keystroke

endif
```
